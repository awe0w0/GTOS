## arch/riscv32/esp32c6/sdkconfig.defaults
```kconfig
CONFIG_ESPTOOLPY_FLASHSIZE_4MB=y
CONFIG_PARTITION_TABLE_SINGLE_APP_LARGE=y
CONFIG_ESP_HOSTED=y
CONFIG_ESP_HOSTED_CP=y
CONFIG_ESP_HOSTED_CP_FOR_MCU=y
CONFIG_ESP_HOSTED_CP_RPC_V2=y
CONFIG_EH_TRANSPORT_CP_SDIO=y
CONFIG_ESP_HOSTED_CP_FEAT_WIFI=y
CONFIG_ESP_HOSTED_CP_FEAT_BT=y
CONFIG_ESP_HOSTED_CP_BT_ENABLED=y
CONFIG_ESP_HOSTED_CP_FEAT_BT_HCI_VHCI=y
CONFIG_BT_ENABLED=y
CONFIG_BT_CONTROLLER_ONLY=y
CONFIG_BT_LE_HCI_INTERFACE_USE_RAM=y
CONFIG_FREERTOS_HZ=1000
```

## arch/riscv32/esp32p4/main/Kconfig.projbuild
```kconfig
menu "GTOS Desktop Bar A3"
    config GTOS_A3_SIMULATION
        bool "Use the virtual display and charging profile"
        default y
        help
            Selects the ESP-EMU framebuffer sink and simulated charger limits.
            For physical boards select n to keep the panel and charging gated
            until validated settings are available.

    config GTOS_A3_WIFI_SSID
        string "Desktop Orbit Wi-Fi network"
        default "A3-LAB" if GTOS_A3_SIMULATION
        default ""
        help
            Leave empty for scan-only operation. A configured station hosts the
            read-only Desktop Orbit status endpoint on its local IPv4 network.

    config GTOS_A3_WIFI_PASSWORD
        string "Desktop Orbit Wi-Fi passphrase"
        default "orbit-lab-test" if GTOS_A3_SIMULATION
        default ""
        help
            WPA2 passphrase for the configured demo network. This setting is
            included in the firmware image.
endmenu
```

## arch/riscv32/esp32p4/sdkconfig.defaults
```kconfig
CONFIG_ESP32P4_REV_MIN_300=y
CONFIG_ESPTOOLPY_FLASHSIZE_16MB=y
CONFIG_SPIRAM=y
CONFIG_SPIRAM_MODE_HEX=y
CONFIG_SPIRAM_SPEED_200M=y
CONFIG_ESP_MAIN_TASK_STACK_SIZE=8192
CONFIG_PARTITION_TABLE_SINGLE_APP_LARGE=y
CONFIG_ESP_HOSTED=y
# CONFIG_ESP_HOSTED_AUTO_CALL_INIT_BEFORE_APP_MAIN is not set
CONFIG_ESP_HOSTED_HOST_FEAT_WIFI=y
CONFIG_ESP_HOSTED_HOST_FEAT_BT=y
CONFIG_ESP_HOSTED_CP_TARGET_ESP32C6=y
CONFIG_ESP_HOSTED_P4_DEV_BOARD_NONE=y
CONFIG_ESP_HOSTED_HOST_TRANSPORT_BUS_SDIO=y
CONFIG_ESP_HOSTED_SDIO_SLOT_1=y
CONFIG_ESP_HOSTED_HOST_SDIO_BUS_WIDTH_4=y
CONFIG_ESP_HOSTED_HOST_SDIO_CLK_KHZ=20000
CONFIG_ESP_HOSTED_HOST_RESET_GPIO=6
CONFIG_ESP_HOSTED_HOST_CP_RESET_STRATEGY_ONLY_IF_NECESSARY=y
# CONFIG_ESP_HOSTED_HOST_TRANSPORT_RESTART_ON_FAILURE is not set
CONFIG_ESP_HOSTED_HOST_SDIO_PIN_CLK=18
CONFIG_ESP_HOSTED_HOST_SDIO_PIN_CMD=19
CONFIG_ESP_HOSTED_HOST_SDIO_PIN_D0=14
CONFIG_ESP_HOSTED_HOST_SDIO_PIN_D1=15
CONFIG_ESP_HOSTED_HOST_SDIO_PIN_D2=16
CONFIG_ESP_HOSTED_HOST_SDIO_PIN_D3=17
CONFIG_ESP_WIFI_REMOTE_LIBRARY_HOSTED=y
CONFIG_BT_ENABLED=y
CONFIG_BT_CONTROLLER_DISABLED=y
CONFIG_BT_NIMBLE_ENABLED=y
CONFIG_BT_BLUEDROID_ENABLED=n
CONFIG_BT_NIMBLE_TRANSPORT_UART=n
CONFIG_BT_NIMBLE_50_FEATURE_SUPPORT=n
# CONFIG_BT_NIMBLE_SECURITY_ENABLE is not set
# CONFIG_BT_NIMBLE_HS_PVCY is not set
```

## arch/riscv32/esp32p4/tests/panel/sdkconfig.defaults
```kconfig
CONFIG_ESP32P4_REV_MIN_300=y
CONFIG_ESPTOOLPY_FLASHSIZE_16MB=y
CONFIG_SPIRAM=y
CONFIG_SPIRAM_MODE_HEX=y
CONFIG_SPIRAM_SPEED_200M=y
CONFIG_ESP_TIMER_SUPPORTS_ISR_DISPATCH_METHOD=y
CONFIG_ESP_MAIN_TASK_STACK_SIZE=8192
CONFIG_COMPILER_OPTIMIZATION_ASSERTIONS_ENABLE=y
```
